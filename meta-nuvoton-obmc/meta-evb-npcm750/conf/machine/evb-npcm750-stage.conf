## meta-nuvoton-obmc/meta-evb-npcm750/conf/machine/evb-npcm750-stage.conf
```bitbake
require ../../../../meta-nuvoton/conf/machine/evb-npcm750.conf

UBOOT_DEVICETREE = "nuvoton-npcm750-evb"

IMAGE_FSTYPES += " cpio.${INITRAMFS_CTYPE}.u-boot"
IMAGE_FSTYPES += "${@bb.utils.contains('DISTRO_FEATURES', \
        'phosphor-mmc', \
        'wic.gz mmc-ext4-tar', \
        '', d)}"

MACHINE_FEATURES += "\
        obmc-phosphor-fan-mgmt \
        obmc-phosphor-chassis-mgmt \
        obmc-phosphor-flash-mgmt \
        obmc-host-ipmi \
        obmc-host-state-mgmt \
        obmc-chassis-state-mgmt \
        obmc-bmc-state-mgmt \
        "

PREFERRED_VERSION_linux-nuvoton ?= "6.1%"

DISTRO_FEATURES:append = " ext2"
MACHINE_FEATURES:append = " ext2"

VIRTUAL-RUNTIME_obmc-host-state-manager = "x86-power-control"
VIRTUAL-RUNTIME_obmc-chassis-state-manager = "x86-power-control"

PREFERRED_PROVIDER_virtual/obmc-chassis-mgmt = "packagegroup-evb-npcm750-apps"
PREFERRED_PROVIDER_virtual/obmc-fan-mgmt = "packagegroup-evb-npcm750-apps"
PREFERRED_PROVIDER_virtual/obmc-flash-mgmt = "packagegroup-evb-npcm750-apps"
PREFERRED_PROVIDER_virtual/obmc-system-mgmt = "packagegroup-evb-npcm750-apps"
PREFERRED_PROVIDER_virtual/phosphor-led-manager-config-native = "evb-npcm750-led-manager-config-native"
PREFERRED_PROVIDER_virtual/obmc-host-ipmi-hw = "phosphor-ipmi-kcs"
```

## meta-nuvoton/conf/machine/include/keys.inc
```bitbake
KEY_SIGN ?= "openssl"

KEY_BB_INDEX ?= "1"
KEY_BL31_INDEX ?= "1"
KEY_OPTEE_INDEX ?= "1"
KEY_UBOOT_INDEX ?= "1"

KEY_BB_ID ?= "11"
KEY_BL31_ID ?= "11"
KEY_OPTEE_ID ?= "11"
KEY_UBOOT_ID ?= "11"

KEY_FOLDER ?= ""
KEY_FOLDER_DEFAULT ?= "${DEPLOY_DIR_IMAGE}/${KEY_SIGN}"
KEY_BB ?= "skmt_ecc_key_1.der"
KEY_BL31 ?= "skmt_ecc_key_1.der"
KEY_OPTEE ?= "skmt_ecc_key_1.der"
KEY_UBOOT ?= "skmt_ecc_key_1.der"
```
